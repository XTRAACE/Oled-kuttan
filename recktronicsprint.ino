#include <Wire.h>
#include <Adafruit_GFX.h>
#include <Adafruit_SSD1306.h>

#define SCREEN_WIDTH 128
#define SCREEN_HEIGHT 64

Adafruit_SSD1306 display(SCREEN_WIDTH, SCREEN_HEIGHT, &Wire, -1);

// 🔥 Your Logo (64x64)
const unsigned char recktronics_logo [] PROGMEM = {
0x00,0x00,0x00,0x00,0x1E,0x00,0x00,0x00,
0x3F,0x80,0x00,0x00,0x7F,0xC0,0x00,0x00,
0x70,0xE0,0x00,0x00,0x70,0x70,0x00,0x00,
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0x70,0x00,0x03,0xE0,0x00,0x00,0x00,0x00
};

void setup() {
  Serial.begin(115200);

  if(!display.begin(SSD1306_SWITCHCAPVCC, 0x3C)) {
    Serial.println("OLED not found");
    for(;;);
  }

  display.clearDisplay();

  // 🔥 Animation: Slide Logo from Left
  for(int x = -64; x <= 32; x++) {
    display.clearDisplay();
    display.drawBitmap(x, 0, recktronics_logo, 64, 64, WHITE);
    display.display();
    delay(10);
  }

  delay(800);

  // 🔥 Show Brand Name
  display.clearDisplay();

  display.setTextSize(2);
  display.setTextColor(SSD1306_WHITE);

  // Center text
  display.setCursor(10, 25);
  display.println("RECKTRONICS");

  display.display();

  delay(2000);

  // 🔥 Final Screen (Logo + Name)
  display.clearDisplay();

  display.drawBitmap(32, 0, recktronics_logo, 64, 64, WHITE);

  display.setTextSize(1);
  display.setCursor(20, 54);
  display.println("RECKTRONICS");

  display.display();
}

void loop() {
}
